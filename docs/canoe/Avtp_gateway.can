/*@!Encoding:1252*/
includes
{
}

variables
{
  // --- Gateway v6.5: source-MAC echo filter + 10ms cadence (100fps) ---
  //
  // ROOT CAUSE of glitches since v6.0:
  //   Gateway rxCount showed ~1000 EOF/sec, but C# only sends 100fps.
  //   Two possible causes (both fixed below):
  //   1) Gateway's own output() creates self-echo packets on the same bus.
  //   2) Another AVTP source (Avtp_new.can generator) also sends on Eth2.
  //   Either way, multiple interleaved sources corrupt rxAssembly — some
  //   lines from source A, some from source B ? visible tearing/glitches.
  //
  // Fix: Gateway uses a DISTINCT source MAC (last byte 0x1A, not 0x19).
  //   RX handler ONLY accepts packets from C# app's MAC (0x19).
  //   This filters out both self-echo AND any CANoe generator node,
  //   since both use different MACs than the C# source.
  //   Stream ID (bytes 4-11) UNCHANGED — ECU compatibility preserved.

  ethernetPacket myStream;

  byte rxImg[25600];       // Latest complete frame copied for TX
  byte rxReady[25600];     // Snapshot: written by RX, consumed by timer
  byte rxAssembly[25600];  // Frame being assembled across multiple RX packets

  int  rxHaveFrame;        // 1 after first complete frame received
  int  rxNewFrame;         // 1 = rxReady has unconsumed frame for timer
  long rxFrameCount;       // Total complete frames received (RX only)
  long rxSnapCount;        // Snapshots actually taken (rxNewFrame was 0)
  long rxFilteredCount;    // Packets filtered out (wrong source MAC)

  const int BUFFER_NR = 20;  // 80 lines / 4 lines per packet = 20 packets

  msTimer txTimer;         // 10ms cadence timer (100fps, same as Avtp_new.can)
  int txSeq;               // sequence number (0..255)
  long txFrameCount;       // Total frames transmitted
  long txStaleCount;       // Timer ticks where no new frame was available

  // MAC addresses: gateway TX uses 0x1A, C# source uses 0x19
  qword csharpSrcMac;      // C# app source MAC (accepted by RX filter)
}

// --- Burst-TX one complete frame (20 packets) ---
void gatewayBurstTx(int useRx)
{
  int k;
  int hc;
  int line0;
  int srcOff;
  int i;

  hc = 1;
  for (k = 0; k < BUFFER_NR; k++)
  {
    if (hc == 1) myStream.byte(1) = 0x81;
    else         myStream.byte(1) = 0x80;

    myStream.byte(2) = txSeq;

    if (k == BUFFER_NR - 1) myStream.byte(22) = 0x90;
    else                     myStream.byte(22) = 0x80;

    myStream.byte(31) = hc;

    line0 = hc - 1;
    srcOff = line0 * 320;

    if (useRx == 1)
    {
      for (i = 0; i < 1280; i++)
        myStream.byte(32 + i) = rxImg[srcOff + i];
    }
    else
    {
      for (i = 0; i < 1280; i++)
        myStream.byte(32 + i) = 0x00;
    }

    output(myStream);

    hc = hc + 4;
    txSeq = txSeq + 1;
    if (txSeq > 255) txSeq = 0;
  }
  txFrameCount = txFrameCount + 1;
}

on start
{
  int i;

  for (i = 0; i < 25600; i++)
  {
    rxImg[i]      = 0x00;
    rxReady[i]    = 0x00;
    rxAssembly[i] = 0x00;
  }
  rxHaveFrame     = 0;
  rxNewFrame      = 0;
  rxFrameCount    = 0;
  rxSnapCount     = 0;
  rxFilteredCount = 0;
  txSeq           = 0;
  txFrameCount    = 0;
  txStaleCount    = 0;

  // C# app sends with this source MAC — ONLY accept packets from this MAC
  csharpSrcMac = EthGetMacAddressAsNumber("3C:CE:15:00:00:19");

  // Gateway retransmits with a DIFFERENT source MAC (last byte 0x1A)
  // so its own output is filtered out by the RX handler.
  myStream.source      = EthGetMacAddressAsNumber("3C:CE:15:00:00:1A");
  myStream.destination = EthGetMacAddressAsNumber("01:00:5E:16:00:12");
  myStream.Length      = 1312;
  myStream.SetVlanId(70);
  myStream.SetVlanPriority(5);
  myStream.type = 0x22F0;

  myStream.byte(0) = 0x07;
  myStream.byte(1) = 0x81;
  myStream.byte(3) = 0x00;

  myStream.byte(4)  = 0x3C;
  myStream.byte(5)  = 0xCE;
  myStream.byte(6)  = 0x15;
  myStream.byte(7)  = 0x00;
  myStream.byte(8)  = 0x00;
  myStream.byte(9)  = 0x19;
  myStream.byte(10) = 0x00;
  myStream.byte(11) = 0x50;

  myStream.byte(12) = 0x00;
  myStream.byte(13) = 0x00;
  myStream.byte(14) = 0x00;
  myStream.byte(15) = 0x00;

  myStream.byte(16) = 0x01;
  myStream.byte(17) = 0x40;
  myStream.byte(18) = 0x00;
  myStream.byte(19) = 0x50;

  myStream.byte(20) = 0x05;
  myStream.byte(21) = 0x08;

  myStream.byte(22) = 0x80;
  myStream.byte(23) = 0x00;

  myStream.byte(24) = 0x00;
  myStream.byte(25) = 0x10;
  myStream.byte(26) = 0x30;
  myStream.byte(27) = 0x44;
  myStream.byte(28) = 0x00;
  myStream.byte(29) = 0x00;
  myStream.byte(30) = 0x00;

  myStream.byte(31) = 0x01;

  // 10ms cadence — identical to Avtp_new.can (proven 100fps)
  setTimerCyclic(txTimer, 0, 10);
}

// --- RX from Eth2: ONLY accept packets from the C# app's source MAC ---
on ethernetPacket msgChannel2.*
{
  int hc;
  int line0;
  int srcOff;
  int i;

  // *** CRITICAL: only accept packets from the C# app (MAC ...19) ***
  // This filters out:
  //   - gateway self-echo (MAC ...1A)
  //   - Avtp_new.can generator (different MAC or same-but-internal)
  //   - any other AVTP source on the bus
  // Result: rxCount matches C# send rate (100fps) exactly.
  if (this.source != csharpSrcMac)
  {
    rxFilteredCount = rxFilteredCount + 1;
    return;
  }

  if (@PANELS::AvtpNodeMode != 1)
    return;

  if (this.type != 0x22F0)
    return;

  if (this.Length < (32 + 1280))
    return;

  hc = this.byte(31);
  line0 = hc - 1;
  if (line0 < 0) return;
  if (line0 >= 80) return;

  // Always assemble — keeps rxAssembly continuously up-to-date
  srcOff = line0 * 320;
  for (i = 0; i < 1280; i++)
  {
    if ((srcOff + i) < 25600)
      rxAssembly[srcOff + i] = this.byte(32 + i);
  }

  // End-of-frame: snapshot if timer consumed the previous one
  if (this.byte(22) == 0x90)
  {
    rxFrameCount = rxFrameCount + 1;
    if (rxNewFrame == 0)
    {
      for (i = 0; i < 25600; i++)
        rxReady[i] = rxAssembly[i];
      rxNewFrame = 1;
      rxSnapCount = rxSnapCount + 1;
    }
    rxHaveFrame = 1;
  }
}

// --- 10ms timer: transmit only a newly received frame ---
on timer txTimer
{
  int i;

  if (@PANELS::AvtpNodeMode != 1)
    return;

  if (rxNewFrame == 1)
  {
    for (i = 0; i < 25600; i++)
      rxImg[i] = rxReady[i];
    rxNewFrame = 0;
  }
  else
  {
    txStaleCount = txStaleCount + 1;
    return;
  }

  gatewayBurstTx(1);
}

on key 'g'
{
  write("Gateway v6.5: mode=%d rxCount=%d snaps=%d txCount=%d stale=%d filtered=%d seq=%d",
        @PANELS::AvtpNodeMode, rxFrameCount, rxSnapCount, txFrameCount, txStaleCount, rxFilteredCount, txSeq);
}
